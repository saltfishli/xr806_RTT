## src/kernel/Kconfig
```kconfig
#
# Kernel configuration
#

menu "Kernel options"

choice
	prompt "RTOS kernel"
	default RTOS_RTTHREAD
	help
		Select RTOS kernel to used

	config RTOS_FREERTOS
		bool "FreeRTOS used"
		select OS_FREERTOS

	config RTOS_RTTHREAD
		bool "RT-Thread used"
		select OS_RTTHREAD
endchoice

config OS_RTTHREAD
	bool
	default n
	help
		RT-Thread used.

# os
config OS_FREERTOS
	bool
	default n
	help
		FreeRTOS used.

source "src/kernel/RT-Thread/Kconfig"

if OS_FREERTOS

# os version
choice
	prompt "FreeRTOS version"
	default FREERTOS_VER_NULL
	help
		Select FreeRTOS version.

config FREERTOS_VER_10_2_1
	bool "FreeRTOS v10.2.1"
	help
		FreeRTOS v10.2.1.

config FREERTOS_VER_NULL
	bool "FreeRTOS NULL"
	help
		FreeRTOS NULL.
endchoice

config OS_FREERTOS_VERSION_STR
	string
	default "v10.2.1" if FREERTOS_VER_10_2_1
	help
	  FreeRTOS version Selsected


# Use os idle hook
config OS_USE_IDLE_HOOK
	bool "FreeRTOS idle hook"
	default n
	depends on ROM_FREERTOS
	help
	  Use freeRTOS idle hook
endif

endmenu
```

## src/kernel/RT-Thread/Kconfig
```kconfig
#
# RT-Thread options
#

if OS_RTTHREAD
menu "RT-Thread options"

config RT_THREAD_PRIORITY_MAX
    int "Maximal level of thread priority"
    range 8 256
    default 8

config RT_TICK_PER_SECOND
    int "OS tick per second"
    default 1000

config RT_ALIGN_SIZE
    int "Alignment size for CPU architecture data access"
    default 4

config RT_NAME_MAX
    int "the max length of object name"
    default 8

config RT_USING_COMPONENTS_INIT
    bool "Using RT-Thread components initialization"
    default y

menuconfig RT_USING_USER_MAIN
    bool "Using user main"
    default y

    config RT_MAIN_THREAD_STACK_SIZE
        depends on RT_USING_USER_MAIN
        int "the stack size of main thread"
        range 1 4086
        default 512

config RT_DEBUG
    bool "enable kernel debug configuration"
    default n

config RT_DEBUG_INIT
    depends on RT_DEBUG
    int "enable components initialization debug configuration"
    range 0 1
    default 0

config RT_USING_OVERFLOW_CHECK
    depends on RT_DEBUG
    bool "enable thread stack over flow detect"
    default y

config RT_USING_HOOK
    bool "using hook"
    default n

config RT_USING_IDLE_HOOK
    depends on RT_USING_HOOK
    bool "using idle hook"
    default n

menuconfig RT_USING_TIMER_SOFT
    bool "Software timers"
    default n
    if RT_USING_TIMER_SOFT
        config RT_TIMER_THREAD_PRIO
            int "The priority level of timer thread"
            range 0 31
            default 4

        config RT_TIMER_THREAD_STACK_SIZE
            int "The stack size of timer thread"
            range 0 8192
            default 512
    endif

menu "Inter-Thread communication"

    config RT_USING_SEMAPHORE
        bool "Enable semaphore"
        default y

    config RT_USING_MUTEX
        bool "Enable mutex"
        default y

    config RT_USING_EVENT
        bool "Enable event flag"
        default y

    config RT_USING_MAILBOX
        bool "Enable mailbox"
        default y

    config RT_USING_MESSAGEQUEUE
        bool "Enable message queue"
        default y

    config RT_USING_SIGNALS
        bool "Enable signals"
        select RT_USING_MEMPOOL
        default n
        help
            A signal is an asynchronous notification sent to a specific thread
            in order to notify it of an event that occurred.
endmenu

menu "Memory Management"

    config RT_USING_MEMPOOL
        bool "Using memory pool"
        default y
        help
            Using static memory fixed partition

    config RT_USING_SMALL_MEM
        bool "Using Small Memory Algorithm"
        default n
        help
            Using Small Memory Algorithm

    config RT_USING_SLAB
        bool "Using SLAB Memory Algorithm"
        default n
        help
            The slab allocator of RT-Thread is a memory allocation algorithm
             optimizedfor embedded systems based on the slab allocator
             implemented by Matthew Dillon, founder of dragonfly BSD.
             The original slab algorithm is an efficient kernel memory
             allocation algorithm introduced by Jeff bonwick for
             Solaris Operating System.

    menuconfig RT_USING_MEMHEAP
        bool "Using memheap Memory Algorithm"
        default n

        if RT_USING_MEMHEAP
            choice
                prompt "Memheap memory allocation mode"
                default RT_MEMHEAP_FAST_MODE

                config RT_MEMHEAP_FAST_MODE
                    bool "fast mode"
                    help
                        Speed priority mode.
                        As long as the memory block size meets the requirements, the search ends immediately.

                config RT_MEMHEAP_BSET_MODE
                    bool "best mode"
                    help
                        Best size first.
                        The search does not end until the memory block of the most appropriate size is found
            endchoice
        endif

    choice
        prompt "System Heap Memory Management"
        default RT_USING_SMALL_MEM_AS_HEAP

        config RT_USING_SMALL_MEM_AS_HEAP
            bool "Small Memory Algorithm"
            select RT_USING_SMALL_MEM

        config RT_USING_MEMHEAP_AS_HEAP
            bool "Use memheap objects as heap"
            select RT_USING_MEMHEAP

            if RT_USING_MEMHEAP_AS_HEAP
                config RT_USING_MEMHEAP_AUTO_BINDING
                    bool "Use all of memheap objects as heap"
                    default y
            endif

        config RT_USING_SLAB_AS_HEAP
            bool "SLAB Algorithm for large memory"
            select RT_USING_SLAB

        config RT_USING_USERHEAP
            bool "Use user heap"
            help
                If this option is selected, please implement these functions:
                    rt_malloc(), rt_malloc_sethook()
                    rt_free(),   rt_free_sethook()
                    rt_calloc(), rt_realloc()
                    rt_memory_info()
                    rt_system_heap_init()

        config RT_USING_NOHEAP
            bool "Disable Heap"
    endchoice

    config RT_USING_MEMTRACE
        bool "Enable memory trace"
        default n
        help
            When enable RT_USING_MEMTRACE with shell, developer can call cmd:
            1. memtrace
                to dump memory block information.
            2. memcheck
                to check memory block to avoid memory overwritten.

            And developer also can call memcheck() in each of scheduling
            to check memory block to find which thread has wrongly modified
            memory.

    config RT_USING_HEAP_ISR
        bool "Using heap in ISR"
        default n
        help
            When this option is enabled, the critical zone will be protected with disable interrupt.

    config RT_USING_HEAP
        bool
        default n if RT_USING_NOHEAP
        default y if RT_USING_SMALL_MEM
        default y if RT_USING_SLAB
        default y if RT_USING_MEMHEAP_AS_HEAP
        default y if RT_USING_USERHEAP
endmenu

menu "Console options"
    config RT_USING_CONSOLE
        bool "Using concole"
        default y

    config RT_CONSOLEBUF_SIZE
        depends on RT_USING_CONSOLE
        int "the buffer size of console"
        range 1 1024
        default 128

    menuconfig RT_USING_FINSH
        bool "Using finsh"
        default n
        if RT_USING_FINSH
            config RT_FINSH_THREAD_PRIORITY
                int "the priority of finsh thread"
                range 1 7
                default 6

            config RT_FINSH_THREAD_STACK_SIZE
                int "the stack of finsh thread"
                range 1 4096
                default 512

            config RT_FINSH_HISTORY_LINES
                int "the history lines of finsh thread"
                range 1 32
                default 5

            config RT_FINSH_USING_SYMTAB
                bool "Using finsh symbol table"
                default y

            config RT_FINSH_USING_DESCRIPTION
                bool "Enable command description"
                default y
        endif
endmenu

endmenu
endif
```
